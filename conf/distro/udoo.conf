## conf/distro/udoo.conf
```bitbake
DISTRO = "udoo"
DISTRO_NAME = "UDOO (Bolt Distro)"
DISTRO_VERSION = "0.0.1"
DISTRO_CODENAME = "barak"
SDK_VENDOR = "-udoosdk"
SDK_VERSION = "${@d.getVar('DISTRO_VERSION').replace('snapshot-${DATE}', 'snapshot')}"

MAINTAINER = "Underview <vince@underview.tech>"

TARGET_VENDOR = "-udoo"

LOCALCONF_VERSION = "2"

DISTRO_VERSION[vardepsexclude] = "DATE"
SDK_VERSION[vardepsexclude] = "DATE"

UDOO_DEFAULT_DISTRO_FEATURES = "largefile opengl ptest multiarch wayland vulkan systemd"
UDOO_DEFAULT_EXTRA_RDEPENDS = "packagegroup-core-boot"
UDOO_DEFAULT_EXTRA_RRECOMMENDS = "kernel-module-af-packet"

DISTRO_FEATURES ?= "${DISTRO_FEATURES_DEFAULT} ${UDOO_DEFAULT_DISTRO_FEATURES}"
DISTRO_EXTRA_RDEPENDS += " ${UDOO_DEFAULT_EXTRA_RDEPENDS}"
DISTRO_EXTRA_RRECOMMENDS += " ${UDOO_DEFAULT_EXTRA_RRECOMMENDS}"

# Replaces sysvinit init system with systemd init system
DISTRO_FEATURES_BACKFILL_CONSIDERED ?= "sysvinit"
VIRTUAL-RUNTIME_init_manager ?= "systemd"
VIRTUAL-RUNTIME_dev_manager ?= "udev"
VIRTUAL-RUNTIME_initscripts ?= ""

PREFERRED_PROVIDER_udev ?= "systemd"
PREFERRED_PROVIDER_udev-utils ?= "systemd"
PREFERRED_VERSION_linux-yocto ?= "5.10%"
PREFERRED_VERSION_linux-yocto-rt ?= "5.10%"

SDK_NAME = "${DISTRO}-${TCLIBC}-${SDKMACHINE}-${IMAGE_BASENAME}-${TUNE_PKGARCH}-${MACHINE}"
SDKPATHINSTALL = "/opt/${DISTRO}/${SDK_VERSION}"

QEMUDEPS = "${@bb.utils.contains("INCOMPATIBLE_LICENSE", "GPL-3.0", "", "packagegroup-core-device-devel",d)}"
DISTRO_EXTRA_RDEPENDS:append:qemuarm = " ${QEMUDEPS}"
DISTRO_EXTRA_RDEPENDS:append:qemuarm64 = " ${QEMUDEPS}"
DISTRO_EXTRA_RDEPENDS:append:qemumips = " ${QEMUDEPS}"
DISTRO_EXTRA_RDEPENDS:append:qemuppc = " ${QEMUDEPS}"
DISTRO_EXTRA_RDEPENDS:append:qemux86 = " ${QEMUDEPS}"
DISTRO_EXTRA_RDEPENDS:append:qemux86-64 = " ${QEMUDEPS}"

TCLIBCAPPEND = ""

PREMIRRORS ??= "\
bzr://.*/.*   http://downloads.yoctoproject.org/mirror/sources/ \n \
cvs://.*/.*   http://downloads.yoctoproject.org/mirror/sources/ \n \
git://.*/.*   http://downloads.yoctoproject.org/mirror/sources/ \n \
gitsm://.*/.* http://downloads.yoctoproject.org/mirror/sources/ \n \
hg://.*/.*    http://downloads.yoctoproject.org/mirror/sources/ \n \
osc://.*/.*   http://downloads.yoctoproject.org/mirror/sources/ \n \
p4://.*/.*    http://downloads.yoctoproject.org/mirror/sources/ \n \
svn://.*/.*   http://downloads.yoctoproject.org/mirror/sources/ \n"

# QA check settings - a little stricter than the OE-Core defaults
WARN_TO_ERROR_QA = "already-stripped compile-host-path install-host-path \
                    installed-vs-shipped ldflags pn-overrides rpaths staticdev \
                    unknown-configure-option useless-rpaths"
WARN_QA:remove = "${WARN_TO_ERROR_QA}"
ERROR_QA:append = " ${WARN_TO_ERROR_QA}"

require conf/distro/include/no-static-libs.inc
require conf/distro/include/yocto-uninative.inc
require conf/distro/include/security_flags.inc
INHERIT += "uninative"

BB_SIGNATURE_HANDLER ?= "OEEquivHash"
BB_HASHSERVE ??= "auto"
```

## conf/layer.conf
```bitbake
# We have a conf and classes directory, add to BBPATH
BBPATH .= ":${LAYERDIR}"

# We have recipes-* directories, add to BBFILES
BBFILES += "${LAYERDIR}/recipes-*/*/*.bb \
            ${LAYERDIR}/recipes-*/*/*.bbappend"

BBFILE_COLLECTIONS += "meta-udoo-bolt"
BBFILE_PATTERN_meta-udoo-bolt = "^${LAYERDIR}/"
BBFILE_PRIORITY_meta-udoo-bolt = "5"

LAYERDEPENDS_meta-udoo-bolt = "core"
LAYERSERIES_COMPAT_meta-udoo-bolt = "styhead"
```

## conf/machine/include/udoo-bolt-common.inc
```bitbake
PREFERRED_PROVIDER_virtual/kernel ?= "linux-yocto"
PREFERRED_VERSION_linux-yocto ?= "6.12%"
PREFERRED_VERSION_linux-yocto-rt ?= "6.12%"
PREFERRED_PROVIDER_jpeg ?= "jpeg"
PREFERRED_PROVIDER_jpeg-native ?= "jpeg-native"

ACPI_DEBUG ?= "0"
ACPI_DEBUG_KERNEL_ARGS ?= "log_buf_len=16M acpi.debug_layer=0x00000002 acpi.debug_level=0x00000004"

KERNEL_IMAGETYPE = "bzImage"

BOLT_BLOCK_DEVICE ?= "/dev/mmcblk0"

UDOO_BOLT_ESSENTIAL_EXTRA_RDEPENDS ?= ""

# QEMU does not support some of the enhanced instructions available
# on the AMD chips which causes some build time failures.
MACHINE_FEATURES:remove = "qemu-usermode"
MACHINE_FEATURES += "wifi efi"
MACHINE_EXTRA_RRECOMMENDS += "kernel-modules alsa-utils"
MACHINE_EXTRA_RRECOMMENDS += "grub parted util-linux-blkid"
MACHINE_ESSENTIAL_EXTRA_RDEPENDS = "linux-firmware-amdgpu ${UDOO_BOLT_ESSENTIAL_EXTRA_RDEPENDS}"

XSERVER ?= "\
    xserver-xorg \
    xf86-input-evdev \
    xf86-video-amdgpu \
    ${@bb.utils.contains('DISTRO_FEATURES', 'opengl', 'xserver-xorg-extension-glx', '', d)} \
    "

OPENGLX_FEATURE_ENABLED ?= "${@bb.utils.contains('DISTRO_FEATURES', 'opengl x11', 'true', 'false', d)}"
```

## conf/machine/include/udoo-bolt-v1000.inc
```bitbake
DEFAULTTUNE ?= "zen1"
MULTILIBS ?= ""

require conf/machine/include/x86/arch-x86.inc
require conf/machine/include/x86/x86-base.inc
require conf/multilib.conf

TUNEVALID[zen1] = "Enable AMD x86 (64 bit) Zen 1 Core Architecture specific optimizations"
TUNECONFLICTS[zen1] = "m32 mx32"

TUNE_CCARGS .= "${@bb.utils.contains('TUNE_FEATURES', 'zen1', ' -march=znver1', '', d)}"
MACHINEOVERRIDES =. "${@bb.utils.contains('TUNE_FEATURES', 'zen1', 'zen1:', '', d)}amd:amdx86:"

AVAILTUNES += "zen1"
TUNE_FEATURES:tune-zen1         = "${TUNE_FEATURES:tune-x86-64} zen1"
TUNE_PKGARCH:tune-zen1          = "zen1"
PACKAGE_EXTRA_ARCHS:tune-zen1   = "${PACKAGE_EXTRA_ARCHS:tune-x86-64} zen1"
BASE_LIB:tune-zen1              = "lib64"
```

## conf/machine/udoo-bolt-usbimage.conf
```bitbake
require udoo-bolt.inc

WKS_FILES ?= "udoo-bolt-usbimage.wks"

INITRD_IMAGE_LIVE ?= "${MLPREFIX}core-image-minimal-initramfs"
INITRD_LIVE ?= "${DEPLOY_DIR_IMAGE}/${INITRD_IMAGE_LIVE}-${MACHINE}.${INITRAMFS_FSTYPES}"

IMAGE_BOOT_FILES:append = "\
  ${ROOTFS};rootfs.img \
  ${INITRD_IMAGE_LIVE}-${MACHINE}.cpio.gz;initrd \
"

# https://www.gnu.org/software/grub/manual/grub/html_node/index.html#SEC_Contents
GRUB_CFG ?= "\
serial --unit=0 --speed=115200 --word=8 --parity=no --stop=1\n\
set gfxmode=auto\n\
set gfxpayload=keep\n\
default=boot\n\n\
# Boot automatically after 0 secs.\n\
set timeout=0\n\n\
menuentry 'boot' {\n\
  linux /bzImage LABEL=boot root=/dev/ram0 console=tty1 console=ttyS0,115200n8 rootfstype=ext4\n\
  initrd /initrd\n\
}\n\
"
```

## conf/machine/udoo-bolt-v1000.inc
```bitbake
# The amdx86.inc file removes MACHINE_FEATURES = "screen",
# Which unadds kernel config symbols CONFIG_DRM & CONFIG_AGP
# for us. Unfortunately, setting MACHINE_FEATURES here just
# gets overriden by the remove. So, we can't add DRM support.
# Avoid usage of amdx86.inc by implemented v1000.conf &
# amdx86.inc here.
require conf/machine/include/tune-zen1.inc
# require conf/machine/include/amdx86.inc
require conf/machine/include/amd-common-configurations.inc
include conf/machine/include/amd-customer-configurations.inc

# Add machine specific AMD features and feature pkgs here
EXTRA_IMAGE_FEATURES += "amd-feature-networking"

MACHINEOVERRIDES =. "amd:amdx86:"

MACHINE_FEATURES += "screen screen-console"

MACHINE_EXTRA_RRECOMMENDS:remove = " rtc-test"

# Mask out recipes for packages we do not support for
# amdx86 but may be required by others. Use '|' sign
# between the patterns.
BBMASK .= "\
.*/meta-amd/common/recipes-support/libtinyxml\
"
```

## conf/machine/udoo-bolt.conf
```bitbake
require conf/machine/v1000.conf

# We only support IMAGE_FSTYPES "wic" and "iso"
IMAGE_FSTYPES = "wic wic.bmap iso"

WKS_FILES ?= "udoo-bolt-usbimage.wks"

# Contents of IMAGE_BOOT_FILES are deployed into "$WKS_FILES" wic image
IMAGE_BOOT_FILES = "\
  ${EFIIMGDIR}${EFIDIR}/*;EFI/BOOT/ \
  ${KERNEL_IMAGETYPE} \
  ${INITRD_IMAGE_LIVE}-${MACHINE}.cpio.gz;initrd \
"
```

## conf/machine/udoo-bolt.inc
```bitbake
require conf/machine/v1000.conf

IMAGE_CLASSES += "efi-boot-populate"

# We only support IMAGE_FSTYPES "wic"
IMAGE_FSTYPES = "ext4 wic wic.gz wic.bmap"

# Contents of IMAGE_BOOT_FILES are deployed into "$WKS_FILES" wic image
IMAGE_BOOT_FILES = "\
  ${EFIIMGDIR}${EFIDIR}/*;EFI/BOOT/ \
  ${EFIIMGDIR}/startup.nsh;startup.nsh \
  ${KERNEL_IMAGETYPE} \
"

# This makes sure that boot files are deployed before do_image_wic starts execution
do_image_wic[depends] += "${IMAGE_BASENAME}:do_bootimg"
do_image_wic[vardeps] += "BOLT_ROOT_DEVICE KERNEL_IMAGETYPE"

PREFERRED_PROVIDER_virtual/kernel ?= "linux-yocto"
PREFERRED_VERSION_linux-yocto ?= "5.15%"
PREFERRED_VERSION_linux-yocto-rt ?= "5.15%"
```

## scripts/lib/wic/canned-wks/emmc.wks
```
# See https://wiki.archlinux.org/title/GPT_fdisk#Partition_type
part bios_boot  --label bios_boot  --fstype none --fixed-size 1M  --part-type 21686148-6449-6E6F-744E-656564454649 --source grub_install --sourceparams="boot_type=hybrid-bios"
part efi_system --label efi_system --fstype vfat --fixed-size 48M --part-type C12A7328-F81F-11D2-BA4B-00A0C93EC93B --source grub_install --sourceparams="boot_type=hybrid-uefi"
part grub_data  --label grub_data  --fstype ext4 --fixed-size 78M --part-type 0FC63DAF-8483-4772-8E79-3D69D8477DE4 --source grub_install --sourceparams="boot_type=modules"
part roots      --label rootfs     --fstype ext4 --source rootfs  --part-type 0FC63DAF-8483-4772-8E79-3D69D8477DE4
bootloader --ptable gpt --source grub-install
```

## scripts/lib/wic/canned-wks/liveusb.wks
```
part /boot --label LIVEUSB --source liveusb_isohybrid --sourceparams="loaders=grub-efi|syslinux"
part /images --label IMAGES --fstype ext4 --source copy_direct
bootloader --ptable msdos --source liveusb_isohybrid
```

## scripts/lib/wic/canned-wks/udoo-bolt-emmc.wks
```
# short-description: Create an EFI disk image without any swap with files from var IMAGE_BOOT_FILES
# long-description: Creates a partitioned EFI disk image without any swap from var IMAGE_BOOT_FILES
# that the user can directly dd to the BOLTS eMMC.

part /boot --source bootimg-partition --sourceparams="loader=grub-efi" --ondisk mmcblk0 --label boot --part-type EF00 --active --align 1024 --use-uuid --fixed-size 128M
part / --source rootfs --ondisk mmcblk0 --fstype=ext4 --label rootfs --align 4096
bootloader --ptable gpt
```

## scripts/lib/wic/canned-wks/udoo-bolt-usbimage.wks
```
# Can find original in meta-amd/meta-amd-distro/scripts/lib/wic/canned-wks/
# short-description: Create USB image with files from var IMAGE_BOOT_FILES
# long-description: Creates a USB image with all files in the IMAGE_BOOT_FILES
# var e.g. bootloader, initrd & kernel.

part /boot --source bootimg-partition --ondisk sda --fstype=vfat --label boot --overhead-factor 1.0 --active --align 1024
part / --source rootfs --ondisk sda --fstype=ext4 --size=1000M --label udoo-bolt-rootfs --align 4096
```
