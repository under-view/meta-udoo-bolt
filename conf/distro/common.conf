## conf/distro/common.conf
```bitbake
DISTRO_NAME = "UDOO OS"
DISTRO_VERSION = "0.0.1"
DISTRO_CODENAME = "bolt"

MAINTAINER = "Underview <vince@underview.tech>"

TARGET_VENDOR = "-udoo"

LOCALCONF_VERSION = "2"

PREMIRRORS = "\
git://.*/.*   http://downloads.yoctoproject.org/mirror/sources/ \n \
gitsm://.*/.* http://downloads.yoctoproject.org/mirror/sources/ \n \
hg://.*/.*    http://downloads.yoctoproject.org/mirror/sources/ \n \
p4://.*/.*    http://downloads.yoctoproject.org/mirror/sources/ \n \
svn://.*/.*   http://downloads.yoctoproject.org/mirror/sources/ \n"

# QA check settings - a little stricter than the OE-Core defaults
WARN_TO_ERROR_QA = "already-stripped compile-host-path install-host-path \
                    installed-vs-shipped ldflags pn-overrides rpaths staticdev \
                    unknown-configure-option useless-rpaths"
WARN_QA:remove = "${WARN_TO_ERROR_QA}"
ERROR_QA:append = " ${WARN_TO_ERROR_QA}"

INHERIT += "uninative"

BB_SIGNATURE_HANDLER ?= "OEEquivHash"

BB_HASHSERVE ??= "auto"
BB_HASHSERVE_DB_DIR ??= "${SSTATE_DIR}"

DISTRO_FEATURES = ""
DISTRO_EXTRA_RDEPENDS += "packagegroup-core-boot"
DISTRO_VERSION[vardepsexclude] = "DATE"

require ./include/support-coreutils.inc
require ./include/support-systemd.inc
```

## conf/distro/emmc.conf
```bitbake
require ./common.conf

GRUB_CONFIG_FILE = "emmc-grub.cfg"

PREFERRED_PROVIDER_virtual/kernel = "emmc-linux"
```

## conf/distro/include/support-coreutils.inc
```bitbake
# Replaces busybox,uutils-coreutils with coreutils
SKIP_RECIPE[uutils-coreutils] = "Don't build this"
SKIP_RECIPE[busybox] = "Don't build this"
VIRTUAL-RUNTIME_syslog = ""
VIRTUAL-RUNTIME_login_manager = "shadow-base"
VIRTUAL-RUNTIME_base-utils = "packagegroup-core-base-utils"
VIRTUAL-RUNTIME_base-utils-hwclock = "util-linux-hwclock"
VIRTUAL-RUNTIME_base-utils-syslog = ""
VIRTUAL-RUNTIME_vim = "vim"

PREFERRED_PROVIDER_virtual/base-utils = "packagegroup-core-base-utils"
PREFERRED_PROVIDER_coreutils = "coreutils"
PREFERRED_PROVIDER_uutils-coreutils = "coreutils"

RDEPENDS:packagegroup-core-base-utils:remove = " parted"
```

## conf/distro/include/support-systemd.inc
```bitbake
# Replaces sysvinit init system with systemd init system
VIRTUAL-RUNTIME_initscripts = ""
VIRTUAL-RUNTIME_init_manager = "systemd"
VIRTUAL-RUNTIME_dev_manager = "systemd"
VIRTUAL-RUNTIME_login_manager = "shadow-base"

PREFERRED_PROVIDER_udev = "systemd"
PREFERRED_PROVIDER_udev-utils = "systemd"

DISTRO_FEATURES_OPTED_OUT:append = " sysvinit"
DISTRO_FEATURES += "usrmerge systemd"

ROOT_HOME = "/root"
```

## conf/distro/liveusb.conf
```bitbake
require ./common.conf

PREFERRED_PROVIDER_virtual/kernel ?= "liveusb-console-linux"

#KERNEL_PACKAGE_NAME ?= "liveusb-console"
KERNEL_ARTIFACT_NAME ?= "liveusb-console-${MACHINE}"
```

## conf/machine/udoo-bolt-emmc.conf
```bitbake
require conf/machine/v1000.conf

SERIAL_CONSOLES ?= "115200;ttyS0"

KERNEL_ARGS ?= "console=tty1 console=ttyS0,115200n8 rootwait rootfstype=ext4"

WKS_FILES = "emmc.wks"
WKS_SEARCH_PATH = "${BOLT_LAYERDIR}/recipes-emmc/images"
```

## conf/machine/udoo-bolt-live-usb.conf
```bitbake
require conf/machine/v1000.conf

SERIAL_CONSOLES ?= "115200;ttyS0"

KERNEL_ARGS ?= "console=tty1 console=ttyS0,115200n8"

WKS_FILES = "liveusb.wks"
WKS_SEARCH_PATH = "${BOLT_LAYERDIR}/recipes-liveusb/images"
```
